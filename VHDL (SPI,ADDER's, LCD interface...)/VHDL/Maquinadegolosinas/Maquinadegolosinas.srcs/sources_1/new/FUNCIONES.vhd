LIBRARY IEEE;
USE ieee.std_logic_1164.ALL;
USE ieee.std_logic_unsigned.ALL;

PACKAGE FUNCIONES IS
 
 
	FUNCTION CONV(CHAR : CHARACTER; M: INTEGER ) RETURN STD_LOGIC_VECTOR;
	FUNCTION CONVLETTER(CHAR : CHARACTER ; M: INTEGER ) RETURN INTEGER;
	

	END;

	PACKAGE BODY FUNCIONES IS
		
		
		FUNCTION CONV(CHAR : CHARACTER ; M :INTEGER) RETURN STD_LOGIC_VECTOR IS

		VARIABLE CARACTER : STD_LOGIC_VECTOR (7 DOWNTO 0);
		VARIABLE TEMP : INTEGER := CHARACTER'POS(CHAR);
 
	BEGIN
	 
	 
	   
	   
		FOR i IN CARACTER'reverse_range LOOP
			CASE TEMP MOD 2 IS
				WHEN 0 => CARACTER(i) := '0';
				WHEN 1 => CARACTER(i) := '1';
				WHEN OTHERS => NULL;
			END CASE;
			TEMP := TEMP/2;
		END LOOP; 
		
		IF( M = 0) THEN
	    RETURN CARACTER;
	    ELSE  
	    RETURN CARACTER + 32;
	    END IF;

END FUNCTION;
	
	
	
	
	FUNCTION CONVLETTER(CHAR : CHARACTER ; M: INTEGER ) RETURN INTEGER IS
            VARIABLE LET : INTEGER := CHARACTER'POS(CHAR);
            BEGIN 
            
            IF M = 0  THEN
            RETURN LET;
            ELSE  
            RETURN LET + 32;
            END IF;
   END FUNCTION;
   

END PACKAGE BODY;
 

